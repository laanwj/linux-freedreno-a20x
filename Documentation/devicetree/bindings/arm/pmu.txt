## Documentation/devicetree/bindings/arm/pmu.txt
```
* ARM Performance Monitor Units

ARM cores often have a PMU for counting cpu and cache events like cache misses
and hits. The interface to the PMU is part of the ARM ARM. The ARM PMU
representation in the device tree should be done as under:-

Required properties:

- compatible : should be one of
	"arm,armv8-pmuv3"
	"arm,cortex-a17-pmu"
	"arm,cortex-a15-pmu"
	"arm,cortex-a12-pmu"
	"arm,cortex-a9-pmu"
	"arm,cortex-a8-pmu"
	"arm,cortex-a7-pmu"
	"arm,cortex-a5-pmu"
	"arm,arm11mpcore-pmu"
	"arm,arm1176-pmu"
	"arm,arm1136-pmu"
	"qcom,krait-pmu"
- interrupts : 1 combined interrupt or 1 per core. If the interrupt is a per-cpu
               interrupt (PPI) then 1 interrupt should be specified.

Optional properties:

- qcom,no-pc-write : Indicates that this PMU doesn't support the 0xc and 0xd
                     events.

- secure-reg-access : Indicates that secure mode access is available.
		      This will cause the driver to do any setup required that
		      is only possible in secure mode.
		      If not present the secure registers will not be touched,
		      which means the PMU may fail to operate unless external
		      code (bootloader or security monitor) has performed the
		      appropriate initialisation.
Example:

pmu {
        compatible = "arm,cortex-a9-pmu";
        interrupts = <100 101>;
};
```

## Documentation/devicetree/bindings/mfd/zii,rave-sp.txt
```
Zodiac Inflight Innovations RAVE Supervisory Processor

Required parent device properties:

 - compatible: Should be one of:
	- "zii,rave-sp-niu"
	- "zii,rave-sp-mezz"
	- "zii,rave-sp-esb"
	- "zii,rave-sp-rdu1"
	- "zii,rave-sp-rdu2"

 - current-speed: Should be set to baud rate SP device is using

RAVE SP consists of the following sub-devices:

Device				 Description
------				 -----------
rave-sp-wdt			: Watchdog


Example of usage:

	rdu {
		compatible = "zii,rave-sp-rdu2";
		current-speed = <1000000>;
		status = "okay";

		watchdog {
			compatible = "zii,rave-sp-watchdog";
			status = "okay";
		};
	};
```

## Documentation/devicetree/bindings/watchdog/zii,rave-sp-wdt.txt
```
Zodiac Inflight Innovations RAVE Supervisory Processor Watchdog

Required properties:

 - compatible: Should be "zii,rave-sp-watchdog"

Optional properties:

 - Two byte nvmem cell "wdt_timeout", specified as per
   Documentation/devicetree/bindings/nvmem/nvmem.txt
```

## drivers/mxc/Kconfig
```kconfig
# drivers/mxc/Kconfig

if ARCH_MXC

menu "MXC support drivers"

source "drivers/mxc/amd-gpu/Kconfig"

endmenu

endif
```

## drivers/mxc/amd-gpu/Kconfig
```kconfig
#
# Bluetooth configuration
#

menu "MXC GPU support"

config MXC_AMD_GPU
	tristate "MXC GPU support"
	depends on SOC_IMX35 || SOC_IMX5
	---help---
         Say Y to get the GPU driver support.

endmenu
```
